## config/boards/shields/ThreeTwelve/Kconfig.defconfig
```kconfig
if SHIELD_THREETWELVE1

config ZMK_KEYBOARD_NAME
    default "ThreeTwelve1"

endif
```

## config/boards/shields/ThreeTwelve2/Kconfig.defconfig
```kconfig
if SHIELD_THREETWELVE21

config ZMK_KEYBOARD_NAME
    default "ThreeTwelve2"

endif
```

## config/boards/shields/ThreeTwelve21/Kconfig.defconfig
```kconfig
if SHIELD_THREETWELVE21

config ZMK_KEYBOARD_NAME
    default "ThreeTwelve21"

endif
```
